#include "ssd1306.h"
#include "main.h"

#include <string.h>

#define SSD1306_I2C_ADDR (0x3CU << 1)

extern I2C_HandleTypeDef hi2c1;

static uint8_t oledBuffer[SSD1306_WIDTH * SSD1306_HEIGHT / 8U];
static uint8_t cursorX = 0U;
static uint8_t cursorY = 0U;
static uint8_t i2cTxBuffer[SSD1306_WIDTH + 1U];

static const uint8_t Font5x7[][5] = {
    {0x00,0x00,0x00,0x00,0x00}, // 0x20 ' '
    {0x00,0x00,0x5F,0x00,0x00}, // 0x21 '!'
    {0x00,0x07,0x00,0x07,0x00}, // 0x22 '"'
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    {0x7F,0x7F,0x7F,0x7F,0x7F}, // 0x7F del (filled)
};

static void SSD1306_WriteCommand(uint8_t command)
{
  uint8_t buffer[2U] = {0x00U, command};
  HAL_I2C_Master_Transmit(&hi2c1, SSD1306_I2C_ADDR, buffer, sizeof(buffer), HAL_MAX_DELAY);
}

static void SSD1306_WriteData(const uint8_t *data, uint16_t size)
{
  if ((data == NULL) || (size == 0U))
  {
    return;
  }

  while (size > 0U)
  {
    uint16_t chunk = (size > SSD1306_WIDTH) ? SSD1306_WIDTH : size;
    i2cTxBuffer[0U] = 0x40U;
    memcpy(&i2cTxBuffer[1U], data, chunk);
    HAL_I2C_Master_Transmit(&hi2c1, SSD1306_I2C_ADDR, i2cTxBuffer, chunk + 1U, HAL_MAX_DELAY);
    data += chunk;
    size -= chunk;
  }
}

void SSD1306_Init(void)
{
  HAL_Delay(50);
  SSD1306_WriteCommand(0xAE); // display off
  SSD1306_WriteCommand(0xD5); // set display clock
  SSD1306_WriteCommand(0x80);
  SSD1306_WriteCommand(0xA8); // multiplex
  SSD1306_WriteCommand(0x3F);
  SSD1306_WriteCommand(0xD3); // display offset
  SSD1306_WriteCommand(0x00);
  SSD1306_WriteCommand(0x40); // start line
  SSD1306_WriteCommand(0x8D); // charge pump
  SSD1306_WriteCommand(0x14);
  SSD1306_WriteCommand(0x20); // memory mode
  SSD1306_WriteCommand(0x00);
  SSD1306_WriteCommand(0xA1); // segment remap
  SSD1306_WriteCommand(0xC8); // COM scan dir
  SSD1306_WriteCommand(0xDA); // COM pins
  SSD1306_WriteCommand(0x12);
  SSD1306_WriteCommand(0x81); // contrast
  SSD1306_WriteCommand(0x7F);
  SSD1306_WriteCommand(0xD9); // pre-charge
  SSD1306_WriteCommand(0xF1);
  SSD1306_WriteCommand(0xDB); // VCOM detect
  SSD1306_WriteCommand(0x40);
  SSD1306_WriteCommand(0xA4); // resume display
  SSD1306_WriteCommand(0xA6); // normal display
  SSD1306_WriteCommand(0x2E); // deactivate scroll
  SSD1306_WriteCommand(0xAF); // display on
  SSD1306_Fill(0U);
  SSD1306_UpdateScreen();
}

void SSD1306_UpdateScreen(void)
{
  for (uint8_t page = 0U; page < (SSD1306_HEIGHT / 8U); ++page)
  {
    SSD1306_WriteCommand(0xB0U + page);
    SSD1306_WriteCommand(0x00U);
    SSD1306_WriteCommand(0x10U);
    SSD1306_WriteData(&oledBuffer[SSD1306_WIDTH * page], SSD1306_WIDTH);
  }
}

void SSD1306_Fill(uint8_t color)
{
  memset(oledBuffer, (color != 0U) ? 0xFFU : 0x00U, sizeof(oledBuffer));
}

void SSD1306_SetCursor(uint8_t x, uint8_t y)
{
  cursorX = x;
  cursorY = y;
}

static void SSD1306_WriteCharStyled(char ch, uint8_t invert)
{
  if ((ch < 0x20) || (ch > 0x7F))
  {
    ch = ' ';
  }

  if ((cursorX + 6U) >= SSD1306_WIDTH)
  {
    return;
  }

  uint16_t index = (uint8_t)(ch - 0x20);
  uint8_t page = cursorY / 8U;
  uint16_t offset = (page * SSD1306_WIDTH) + cursorX;

  for (uint8_t i = 0U; i < 5U; ++i)
  {
    uint8_t column = Font5x7[index][i];
    if (invert != 0U)
    {
      column = (uint8_t)~column;
    }
    oledBuffer[offset + i] = column;
  }
  oledBuffer[offset + 5U] = (invert != 0U) ? 0xFFU : 0x00U;
  cursorX += 6U;
}

void SSD1306_WriteString(const char *text)
{
  while ((text != NULL) && (*text != '\0'))
  {
    SSD1306_WriteCharStyled(*text, 0U);
    ++text;
  }
}

void SSD1306_WriteStringStyled(const char *text, uint8_t invert)
{
  while ((text != NULL) && (*text != '\0'))
  {
    SSD1306_WriteCharStyled(*text, invert);
    ++text;
  }
}
